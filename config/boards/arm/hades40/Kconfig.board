## config/boards/arm/hades40/Kconfig.board
```kconfig
# Copyright (c) 2021 The ZMK Contributors
# SPDX-License-Identifier: MIT

config BOARD_HADES40_V1
	bool "hades40 v1"
	depends on SOC_NRF52840_QIAA
```

## config/west.yml
```yaml
manifest:
  remotes:
    - name: zmkfirmware
      url-base: https://github.com/zmkfirmware
    - name: doantruonglam
      url-base: https://github.com/doantruonglam
    - name: zmkfirmware-infused-kim
      url-base: https://github.com/infused-kim
  projects:
    - name: zmk
      remote: zmkfirmware-infused-kim
      revision: my-changes/oled-ext-pwr
      import: app/west.yml
  self:
    path: config
```
